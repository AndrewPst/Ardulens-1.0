#pragma once

#include <Arduino.h>
#include <PagesController.h>
#include <Page.h>
#include <Display.h>
#include <DataParser.h>
#include <Resource.h>

#include <Fonts/FontsRus/FreeSerif12.h>

static const uint8_t MusicNextIcon[] PROGMEM{
    0x00,
    0x03,
    0x80,
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    0x18,
};

static const uint8_t MusicPreviousIcon[] PROGMEM{
    0x60,
    0x07,
    0x00,
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    0x00,
};

static const uint8_t MusicPauseIcon[] PROGMEM{
    0x00,
    0x03,
    0xfc,
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    0x00,
};

static const uint8_t MusicResumeIcon[] PROGMEM{
    0x00,
    0x03,
    0xfc,
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    0x00,
};

static const uint8_t MusicVolumeIcon[] PROGMEM{
    0x00,
    0x03,
    0x00,
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    0x00,
};

#define PAUSE_RESUME_KEY "1"
#define PREVIOUS_KEY "2"
#define NEXT_KEY "3"
#define UP_VOLUME_KEY "4"
#define DOWN_VOLUME_KEY "5"

class MusicPage : public PageBase
{
private:
    bool isVolumeMode_ = false;
    bool isMusicPlaying_ = false;
    uint8_t volume_ = 0;
    uint8_t *animCounter = nullptr;
    int8_t *dir = nullptr;
    TFT_eSprite *anim;
    uint32_t timer = 0;

    char* musicWord_;

public:
    void onCreate() override
    {
        musicWord_ = display.convertUTF8((char*)resource[7]);

        animCounter = new uint8_t[3]{0};
        dir = new int8_t[3]{1, 3, 4};

        anim = new TFT_eSprite(&display);
        anim->setColorDepth(8);
        anim->createSprite(18, 30);
        pages.setNotificationEnabled(false);
        updateScreen();
    }

    void onTick() override
    {
        if (!isVolumeMode_)
        {
            if (millis() - timer > 30)
            {
                anim->fillSprite(TFT_RED);
                for (uint8_t i = 0; i < 3; i++)
                {
                    anim->fillRect(i * 6, animCounter[i], 4, 30 - animCounter[i], TFT_WHITE);
                    animCounter[i] += dir[i];
                    if (animCounter[i] <= 0 || animCounter[i] >= 20)
                        dir[i] = -dir[i];
                }
                anim->pushSprite(88, 10);
                timer = millis();
            }
        }
    }

    void onAction(DataParser *data) override
    {
        bool isMusicPlaying = data->getParameter(1)[0] == '1';
        uint8_t volume = constrain(atoi(data->getParameter(2)), 0, 100);
        if (volume == volume_ && isMusicPlaying_ == isMusicPlaying)
            return;
        isMusicPlaying_ = isMusicPlaying;
        volume_ = volume;
        updateScreen();
    }

    void onButtonClicked(ButtonAction_t button, ButtonKeys key) override
    {
        char *text = nullptr;
        if (button == B_MULTICLICK && !isVolumeMode_)
        {
            if (buttons[key]->getClicksCount() == 1)
                text = (char *)PAUSE_RESUME_KEY;
            else
                text = (char *)((key == BUTTON_BACK) ? PREVIOUS_KEY : NEXT_KEY);
        }
        else if (button == B_HOLDED)
        {
            isVolumeMode_ = !isVolumeMode_;
            updateScreen();
        }
        else if (button == B_CLICK && isVolumeMode_)
        {
            text = (char *)((key == BUTTON_BACK) ? DOWN_VOLUME_KEY : UP_VOLUME_KEY);
        }
        if (text != nullptr)
            ble.send(CMDKEY_CMDPAGE, {"music_p", text});
    }

    void updateScreen()
    {
        display.fillScreen(TFT_RED);
        if (isVolumeMode_)
            drawVolumeMenu();
        else
            drawPlayerMenu();
    }

    void drawPlayerMenu()
    {
        display.setTextDatum(TL_DATUM);
        display.setTextColor(TFT_WHITE);
        display.setFontSize(5);
        display.drawString(musicWord_, 2, 14);
        display.drawBitmap(6, 48, MusicNextIcon, 30, 22, TFT_WHITE, TFT_RED);
        display.drawBitmap(42, 40, !isMusicPlaying_ ? MusicResumeIcon : MusicPauseIcon, 36, 36, TFT_WHITE, TFT_RED);
        display.drawBitmap(84, 48, MusicPreviousIcon, 30, 22, TFT_WHITE, TFT_RED);
    }

    void drawVolumeMenu()
    {
        display.drawBitmap(10, 10, MusicVolumeIcon, 30, 30, TFT_WHITE, TFT_RED);
        display.fillRoundRect(10, 48, volume_, 5, 3, TFT_WHITE);
        display.setTextDatum(TL_DATUM);
        display.setTextColor(TFT_WHITE);
        display.setFontSize(5);
        display.drawString((String(volume_) + '%').c_str(), 45, 16);
        display.fillCircle(10 + volume_, 50, 6, volume_ < 60 ? TFT_GREEN : TFT_ORANGE);
    }

    void onDestroy() override
    {
        pages.setNotificationEnabled(true);
        delete anim;
        delete dir;
        delete[] musicWord_;
    }

    void drawPreviousMusicButton() {}
    void pauseResumeMusicButton() {}
    void nextMusicButton() {}
};

class MusicPageShell : public PageShell
{
public:
    PageBase *GetInstancePage() override
    {
        return new MusicPage();
    }
    const char *getKey() override
    {
        return "music_p";
    }
};